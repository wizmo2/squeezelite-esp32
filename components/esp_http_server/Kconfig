## main/Kconfig.projbuild
```kconfig
# This is a hack but it overrides some LWIP Kconfig 
# parameters because we are first
config LWIP_MAX_SOCKETS
	range 1 32

menu "Squeezelite-ESP32"

	menu "Target"
		choice OUTPUT_TYPE
			prompt "Main system"
			   default BASIC_I2C_BT
			   help
				   Type of hardware platform
			config SQUEEZEAMP
				bool "SqueezeAMP"
			config MUSE
				bool "Muse"
			config BASIC_I2C_BT
				bool "Generic I2S & Bluetooth"				
			config TWATCH2020	
				bool "T-WATCH2020 by LilyGo"		
		endchoice	

		config WITH_CONFIG_UI
			bool "Enable config UI"
			default n
			help
				Enable configuring system options with the UI
		config WITH_METRICS
			bool "Enable Metrics"
			default n
			help
				Enable capturing and reporting anonymous metrics
		config RELEASE_API
			string "Software update URL"
			default "https://api.github.com/repos/sle118/squeezelite-esp32/releases"
			help
				Set the URL of the API that the front-end UI will use to fetch software updates
		config SQUEEZELITE_ESP32_RELEASE_URL
			string "Release URL"
			default "https://github.com/sle118/squeezelite-esp32/releases"
			help
				Set the URL where users can see a list of releases
		# you can't change default values once they are set so changing "Target" will not reset
		# project name if they are visible config - they have to be silent strings
		config PROJECT_NAME
			string "Project Name"
			default "SqueezeAMP" if SQUEEZEAMP
			default "Squeezelite-TWATCH" if TWATCH2020
			default "Muse" if MUSE
			default "SqueezeESP32"
		config FW_PLATFORM_NAME
			string "Platform Name"
			default "SqueezeAmp" if SQUEEZEAMP
			default "TWATCH" if TWATCH2020
			default "Muse" if MUSE
			default "ESP32"
		# can we use FW_PLATFORM NAME for this?  or is it a cmkae thing
		config TARGET
			string "Set Target configuration"
			default "muse" if MUSE
			default ""		
		config TARGET_LOCKED
			bool "Platform Target is locked"
			depends on OUTPUT_TYPE != BASIC_I2C_BT
			default y

		menu "Factory Configuration"

			config AUDIO_CONTROLS
				string "audio_control_set"
				default "[{\"gpio\":32, \"pull\":true, \"long_press\":1000, \"normal\":{\"pressed\":\"ACTRLS_VOLDOWN\"}, \"longpress\":{\"pressed\":\"ACTRLS_PREV\"}}, {\"gpio\":19, \"pull\":true, \"long_press\":1000, \"normal\":{\"pressed\":\"ACTRLS_VOLUP\"}, \"longpress\":{\"pressed\":\"ACTRLS_NEXT\"}}, {\"gpio\":12, \"pull\":true, \"long_press\":1000, \"normal\":{\"pressed\":\"ACTRLS_TOGGLE\"},\"longpress\":{\"pressed\":\"ACTRLS_POWER\"}}]" if MUSE
				default ""
				help
					Configuration of buttons (see README for syntax)

			config BAT_CONFIG
				string "bat_config"
				default "channel=7,scale=20.24,atten=0" if SQUEEZEAMP
				default "channel=5,scale=7.00,atten=3,cells=1" if MUSE
				default ""			
				help
					Sets parameters for battery voltage measure
					channel=<0..7>,scale=<ratio_to_4096>,atten=<adc_atten>,cells=<1..3>
			config BAT_LOCKED
				bool "battery Config is locked"
				depends on BAT_CONFIG != ""

			config DAC_CONFIG
				string "dac_config"
				default "model=TAS57xx,bck=33,ws=25,do=32,sda=27,scl=26,mute=14:0" if SQUEEZEAMP
				default "model=I2S,bck=26,ws=25,do=33,i2c=53,sda=21,scl=22" if TWATCH2020
				default "model=I2S,bck=5,ws=25,do=26,di=35,i2c=16,sda=18,scl=23,mck" if MUSE
				default ""
			config DAC_LOCKED
				bool "DAC is Locked"
				depends on DAC_CONFIG != ""
				default y
			config DAC_CONTROLSET
				string "dac_control_set"
				default "{ \"init\": [ {\"reg\":41, \"val\":128}, {\"reg\":18, \"val\":255} ], \"poweron\": [ {\"reg\":18, \"val\":64, \"mode\":\"or\"} ], \"poweroff\": [ {\"reg\":18, \"val\":191, \"mode\":\"and\"} ] }" if TWATCH2020
				default "{\"init\":[ {\"reg\":0,\"val\":128}, {\"reg\":0,\"val\":0}, {\"reg\":25,\"val\":4}, {\"reg\":1,\"val\":80}, {\"reg\":2,\"val\":0},	{\"reg\":8,\"val\":0}, {\"reg\":4,\"val\":192},	{\"reg\":0,\"val\":18}, {\"reg\":1,\"val\":0}, {\"reg\":23,\"val\":24}, {\"reg\":24,\"val\":2}, {\"reg\":38,\"val\":9}, {\"reg\":39,\"val\":144}, {\"reg\":42,\"val\":144}, {\"reg\":43,\"val\":128}, {\"reg\":45,\"val\":128}, {\"reg\":27,\"val\":0}, {\"reg\":26,\"val\":0}, {\"reg\":2,\"val\":240}, {\"reg\":2,\"val\":0},	{\"reg\":29,\"val\":28}, {\"reg\":4,\"val\":48}, {\"reg\":25,\"val\":0}, {\"reg\":46,\"val\":33}, {\"reg\":47,\"val\":33} ]}" if MUSE
				default ""	
			config DAC_I2S_NUM
				int "I2S channel (0 or 1)"
				default 0
				help
					I2S dma channel to use.

			config DISPLAY_CONFIG
				string "display_config"
				default "SPI,driver=ST7789,width=240,height=240,cs=5,back=12,speed=16000000,HFlip,VFlip" if TWATCH2020
			config DISPLAY_LOCKED
				bool "Display is locked"
				depends on DISPLAY_CONFIG != ""
				default y
		
			config ETH_CONFIG
				string "eth_config"
				default ""

			config GPIO_EXP_CONFIG		
				string "gpio_exp_config"
				default	""
				help
					Set parameters of GPIO extender
					model=<model>[,addr=<addr>][,base=<100..N>][,count=<0..32>][,intr=<gpio>][,port=dac|system]	

			config SPDIF_CONFIG
				string "spdif_config"
				default "bck=33,ws=25,do=15" if SQUEEZEAMP
				default	""
			config SPDIF_LOCKED
				bool "SPDIF is locked"
				depends on SPDIF_CONFIG != ""
				default y
	
			config I2C_CONFIG
				string "i2c_config"
				default ""
				help
					Set parameters of shared I2C interface
					sda=<gpio>,scl=<gpio>[,speed=<num>][,port=<0|1>]
			config I2C_LOCKED 
				bool "I2C is locked"
				depends on I2C_CONFIG != ""
				default y

			config LED_VU_CONFIG
				string "led_vu_config"
				default ""
				help
					Set parameters for LED strip settings, leave empty for no screen
					type=[WS2812|APA102],length=<n>,gpio=<gpio>[,clk=<gpio>]
			config LED_VU_LOCKED
				bool "Led Visualizer is locked"
				depends on LED_VU_CONFIG != ""
				default y

			config ROTARY_ENCODER
				string "rotary_config"
				default ""
				help
					Set GPIO for rotary encoder (quadrature phase). See README on SqueezeESP32 project's GitHub for more details
					A=<gpio>,B=<gpio>[,SW=gpio>[[,knobonly[=<ms>]|[,volume][,longpress]]			
			config ROTARY_ENCODER_LOCKED
				bool "Rotary Encoder is locked"
				depends on ROTARY_ENCODER != ""
				default y
				
			config SPI_CONFIG
				string "spi_config"
				default "dc=27,data=19,clk=18" if TWATCH2020	
				default "mosi=15,miso=2,clk=14"	if MUSE
				default	""  
				help
					Set parameters of shared SPI interface
					data=<gpio>,clk=<gpio>[,d/c=<num>][,host=<0|1|2>]       
			config SPI_LOCKED
				bool "SPI is locked"
				depends on SPI_CONFIG != ""
				default y
						
			menu "Factory GPIO Configuration"	

				config AMP_GPIO		
					int "set_GPIO_amp"
					default 21 if MUSE
					default -1
					help
						GPIO to switch on/off external amplifier. Set to -1 for no amplifier. 
				config AMP_LOCKED
					bool "Amp Control output is locked"
					depends on AMP_GPIO != -1
				config AMP_GPIO_LEVEL
				int "Active level(0/1)"
				default 1

				config JACK_GPIO
					int "set_GPIO_jack"
					default 34 if SQUEEZEAMP || MUSE
					default -1			
					help
						GPIO to detect speaker jack insertion. Set to -1 for no detection.
				config JACK_LOCKED
					bool "Jack Behaviour output is locked"
					depends on JACK_GPIO != -1
				config JACK_GPIO_LEVEL
					int "Level when inserted (0/1)"
					default 0

				config LED_GREEN_GPIO
					int "set_GPIO_green"
					default 12 if SQUEEZEAMP
					default -1
					help
						Set to -1 for no LED
				config LED_GREEN_GPIO_LEVEL
					int "Green led ON level"
					default 1
				config LED_RED_GPIO
					int "set_GPIO_red"
					default 13 if SQUEEZEAMP
					default -1
					help
						Set to -1 for no LED
				config LED_RED_GPIO_LEVEL
					int "Red led ON level"
					default 0 if SQUEEZEAMP
					default 1
				config LED_LOCKED
					bool "Led Control is locked"
					depends on (LED_GREEN_GPIO != 1 || LED_RED_GPIO != 1)
					default y

				config MUTE_GPIO
					int "GPIO for muting DAC"
					default -1
					help
						GPIO used to mute DAC (not used mostly, leave it to -1).
				config MUTE_GPIO_LEVEL
					int "Mute GPIO active level"
					default 1

				config POWER_GPIO		
					int "set_GPIO_power"
					default -1		
					help
						GPIO that is switched when LMS turns player one. Set to -1 to disable
				config POWER_GPIO_LEVEL
					int "Power active level(0/1)"
					default 1						

				config SPKFAULT_GPIO
					int "set_GPIO_spkfault"
					default 2 if SQUEEZEAMP
					default -1			
					help
						GPIO to detect speaker fault condition. Set to -1 for no detection.
				config SPKFAULT_LOCKED
					bool "Speaker Fault input is locked"
					default y
				config SPKFAULT_GPIO_LEVEL
					int "Level when fault (0/1)"
					default 0

				config SET_GPIO
					string "set_GPIO"
					default "0=ir" if SQUEEZEAMP
					default "" if TWATCH2020
					help
						Set parameters of shared GPIO with special values.
						<gpio_1>=Vcc|GND|amp[:0|1]|jack[:0|1][ir][spkfault[:0|1][,<gpio_n>=Vcc|GND|amp[:0|1]|jack[:0|1]]
						'amp'  => GPIO that is set when playback starts
						'jack' => GPIO used for audio jack detection
						'green', 'red' => GPIO for status LED
						'spkfault' => GPIO used for speaker fault detection
						'ir' => GPIO used for Infrared Receiver
						[:0|1] means set the active value for that GPIO can be low or high

			endmenu
		endmenu
	
		menu "Factory A2DP settings"
		    config A2DP_SINK_NAME
		        string "Name of Bluetooth A2DP device"
		        default "SMSL BT4.2"
		        help
		            This is the name of the bluetooth speaker that Squeezelite will try connecting to.
		    config A2DP_DEV_NAME
		        string "Name of Squeezelite device to use when connecting to A2DP device"
		        default "Squeezelite"
		        help
		            This is the name of the device that the Bluetooth speaker will see when it is connected to.
		    config A2DP_CONTROL_DELAY_MS
				int "Control loop delay"
		        default 500
		        help
		            Decreasing this will lead to a more responsive BT control, but might lead to noisy log files if debug is enabled.
		    config A2DP_CONNECT_TIMEOUT_MS
		    	int "Time out duration when trying to connect to an A2DP audio sink"
		        default 1000
		        help
		            Increasing this value will give more chance for less stable connections to be established.
		endmenu
	endmenu

	menu "Audio Input"
		visible if !PURE
		config BT_SINK
			bool "Bluetooth receiver"
			default n if PURE
			default y
			help
				Enable bluetooth sink (Note that you obviously can't at the same time be a Bluetooth receiver and transmitter)
		config BT_NAME
			depends on BT_SINK
			string "Name of Bluetooth A2DP device"
		        default "ESP32-BT"
		    help
				This is the name of the bluetooth speaker that will be broadcasted
		config BT_SINK_PIN
			depends on BT_SINK
			int "Bluetooth PIN code"
		        default 1234
		config AIRPLAY_SINK
			bool "AirPlay receiver"
			default n if PURE
			default y
		config AIRPLAY_NAME
			depends on AIRPLAY_SINK
			string "Name of AirPlay device"
				default "ESP32-AirPlay"
		    help
				This is the name of the AirPlay speaker that will be broadcasted
		config AIRPLAY_PORT
			depends on AIRPLAY_SINK
			string "AirPlay listening port"
				default "5000"
			help
				AirPlay service listening port
		config CSPOT_SINK
			bool "Spotify (cspot) receiver"
			default n if PURE
			default y
			help
				Enable Spotify connect using CSpot		
	endmenu
			
	menu "Command Sets"
		config DEFAULT_COMMAND_LINE
			string "Command line to execute in Analogue mode"
			default "squeezelite -o I2S -b 500:2000 -d all=info -C 30"
			help
				This is command to run when starting the device
		config DEFAULT_COMMAND_2_LINE
			string "Command line to execute in Digital Mode"
			default "squeezelite -o spdif -b 500:2000 -d all=info -C 30"
			help
				This is the command to run when starting the device in set 2
		config DEFAULT_COMMAND_3_LINE
			string "Command line to execute in Bluetooth Mode"
			default "squeezelite -o bt -b 500:2000 -d all=info -C 30 -Z 44100"
			help
				This is the command to run when starting the device in set 3
	endmenu
endmenu
```
